## west.yml
```yaml
manifest:
  defaults:
    remote: boo

  remotes:
    - name: boo
      url-base: git@github.com:By-Our-Own
    - name: zephyrproject
      url-base: https://github.com/zephyrproject-rtos

  projects:
    - name: zephyr
      repo-path: boo-zephyr
      path: 3rd-party/zephyr
      west-commands: scripts/west-commands.yml
      revision: ddca624ed5bacbfde9c74e4ad810a08385338bf5
    - name: hal_st
      path: 3rd-party/modules/hal/st
      remote: zephyrproject
      revision: fa481784b3c49780f18d50bafe00390ccb62b2ec
    - name: hal_stm32
      path: 3rd-party/modules/hal/stm32
      remote: zephyrproject
      revision: dee4413253623ec575bb8b58abd56f91afe903bb

  self:
    path: altimate
```

## zephyr/Kconfig
```kconfig
#
# Copyright (c) 2020 Ioannis Konstantelias
#
# SPDX-License-Identifier: Apache-2.0
# 

menu "BOO Altimate"

# rsource "samples/Kconfig"
rsource "drivers/Kconfig"

endmenu
```

## zephyr/drivers/Kconfig
```kconfig
#
# Copyright (c) 2020 Ioannis Konstantelias
#
# SPDX-License-Identifier: Apache-2.0
# 

menu "Device Drivers"

rsource "sensor/Kconfig"

endmenu
```

## zephyr/drivers/sensor/Kconfig
```kconfig
#
# Copyright (c) 2020 Ioannis Konstantelias
#
# SPDX-License-Identifier: Apache-2.0
# 

menuconfig SENSOR
    bool "Sensor Drivers"
    help
        Include sensor drivers in config

if SENSOR

rsource "bmp388/Kconfig"

endif # SENSOR
```
